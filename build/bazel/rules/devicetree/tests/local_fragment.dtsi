// Copyright 2026 The Fuchsia Authors. All rights reserved.
// Use of this source code is governed by a BSD-style license that can be
// found in the LICENSE file.

/ {
	fragment-node@3000 {
		reg = <0x3000 0x100>;
	};
};
